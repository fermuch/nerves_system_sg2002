## Config.in
```kconfig
# Add project-specific packages for Buildroot here

source "$NERVES_DEFCONFIG_DIR/package/cvitekconfig/Config.in"

menu "Custom Packages"
source "$NERVES_DEFCONFIG_DIR/package/Config.in"
endmenu

menu "BootLoaders"
source "$NERVES_DEFCONFIG_DIR/boot/Config.in"
endmenu

#menu "Host Packages"
#source "$NERVES_DEFCONFIG_DIR/package/Config.in.host"
#endmenu
```

## nerves_defconfig
```kconfig
BR2_CCACHE=y
BR2_CCACHE_DIR=$HOME/.buildroot-ccache
BR2_CCACHE_INITIAL_SETUP="--max-size=12G"
BR2_JLEVEL=0
BR2_PER_PACKAGE_DIRECTORIES=n
BR2_BACKUP_SITE="http://dl.nerves-project.org"
BR2_DL_DIR=$HOME/.nerves/dl

BR2_riscv=y
BR2_riscv_custom=y
BR2_RISCV_ISA_RVM=y
BR2_RISCV_ISA_RVA=y
BR2_RISCV_ISA_RVF=y
BR2_RISCV_ISA_RVD=y
BR2_RISCV_ISA_RVC=y

# from SG2002 original
BR2_TOOLCHAIN_EXTERNAL=y
BR2_TOOLCHAIN_EXTERNAL_DOWNLOAD=y
BR2_TOOLCHAIN_EXTERNAL_URL="https://github.com/sophgo/host-tools/archive/9c032cf5ff951c26a0747b738c7c6291513ac8d7.tar.gz"
BR2_TOOLCHAIN_EXTERNAL_REL_BIN_PATH="gcc/riscv64-linux-musl-x86_64/bin/"
BR2_TOOLCHAIN_EXTERNAL_CUSTOM_PREFIX="riscv64-unknown-linux-musl"
BR2_TOOLCHAIN_EXTERNAL_GCC_10=y
BR2_TOOLCHAIN_EXTERNAL_HEADERS_5_10=y
BR2_TOOLCHAIN_EXTERNAL_CUSTOM_MUSL=y
BR2_TOOLCHAIN_EXTERNAL_INET_RPC=n
BR2_TOOLCHAIN_EXTERNAL_CXX=y
BR2_TOOLCHAIN_EXTERNAL_OPENMP=y

BR2_TARGET_LDFLAGS="-latomic"
BR2_CPAN_MIRROR="http://cpan.metacpan.org"
BR2_TARGET_GENERIC_HOSTNAME="recamera"
BR2_ROOTFS_DEVICE_CREATION_DYNAMIC_MDEV=y
BR2_TARGET_TZ_INFO=y

BR2_LINUX_KERNEL=y
BR2_LINUX_KERNEL_CUSTOM_GIT=y
BR2_LINUX_KERNEL_CUSTOM_REPO_URL="https://github.com/sophgo/linux_5.10.git"
BR2_LINUX_KERNEL_CUSTOM_REPO_VERSION="085eec53fc4d1935e6736ddad1d6dce5f755dc20"
BR2_LINUX_KERNEL_USE_CUSTOM_CONFIG=y
BR2_LINUX_KERNEL_CUSTOM_CONFIG_FILE="$(NERVES_DEFCONFIG_DIR)/board/sipeed/recamera/linux_defconfig"
BR2_LINUX_KERNEL_IMAGEGZ=y
BR2_LINUX_KERNEL_DTS_SUPPORT=y
BR2_LINUX_KERNEL_CUSTOM_DTS_PATH="$(NERVES_DEFCONFIG_DIR)/board/sipeed/recamera/dts/sg2002_recamera_sd.dts $(NERVES_DEFCONFIG_DIR)/board/sipeed/recamera/dts/*.dtsi $(@D)/include/cvi_board_memmap.h"
BR2_LINUX_KERNEL_DTB_OVERLAY_SUPPORT=y
BR2_LINUX_KERNEL_INSTALL_TARGET=y
BR2_LINUX_KERNEL_NEEDS_HOST_OPENSSL=y
BR2_LINUX_KERNEL_XZ=y

BR2_PACKAGE_LINUX_TOOLS_GPIO=y
BR2_PACKAGE_LINUX_TOOLS_IIO=y
BR2_PACKAGE_BUSYBOX_CONFIG="$(NERVES_DEFCONFIG_DIR)/board/sipeed/recamera/busybox_defconfig"
BR2_PACKAGE_BUSYBOX_SHOW_OTHERS=y
# needed for uevent
BR2_PACKAGE_LIBMNL=y

# from nerves_toolchain_riscv64_nerves_linux_gnu
CT_EXPERIMENTAL=y
CT_LOCAL_TARBALLS_DIR="${CT_TOP_DIR}/../dl"
CT_ARCH_RISCV=y
CT_MULTILIB=y
CT_ARCH_USE_MMU=y
CT_ARCH_64=y
CT_ARCH_ARCH="rv64gc"
CT_KERNEL_LINUX=y
CT_LINUX_V_5_10=y
# CT_CREATE_LDSO_CONF is not set
CT_DEBUG_GDB=y

# Wireless tools
BR2_PACKAGE_IW=y

# File utilities
BR2_PACKAGE_FILE=y

BR2_PACKAGE_WIRELESS_REGDB=y
BR2_PACKAGE_WPA_SUPPLICANT=y
BR2_PACKAGE_WPA_SUPPLICANT_WIRED=y
BR2_PACKAGE_WPA_SUPPLICANT_AP_SUPPORT=y
BR2_PACKAGE_WPA_SUPPLICANT_MESH_NETWORKING=y
BR2_PACKAGE_WPA_SUPPLICANT_AUTOSCAN=y
BR2_PACKAGE_WPA_SUPPLICANT_HOTSPOT=y
BR2_PACKAGE_WPA_SUPPLICANT_DEBUG_SYSLOG=y
BR2_PACKAGE_WPA_SUPPLICANT_WPS=y
BR2_PACKAGE_WPA_SUPPLICANT_WPA3=y
BR2_PACKAGE_WPA_SUPPLICANT_CTRL_IFACE=y


BR2_TARGET_ROOTFS_SQUASHFS=y
BR2_TARGET_ROOTFS_SQUASHFS4_ZLIB=y
BR2_TARGET_OPENSBI=y
BR2_TARGET_OPENSBI_CUSTOM_GIT=y
BR2_TARGET_OPENSBI_CUSTOM_REPO_URL="https://github.com/sophgo/opensbi.git"
BR2_TARGET_OPENSBI_CUSTOM_REPO_VERSION="6766e9cc96df51cde91540f9a15f291bf843b682"
BR2_TARGET_OPENSBI_VERSION="6766e9cc96df51cde91540f9a15f291bf843b682"
BR2_TARGET_OPENSBI_PLAT="generic"
BR2_TARGET_OPENSBI_INSTALL_DYNAMIC_IMG=y
BR2_TARGET_OPENSBI_INSTALL_PAYLOAD_IMG=y
BR2_TARGET_OPENSBI_UBOOT_PAYLOAD=y
BR2_TARGET_OPENSBI_FW_FDT_PATH=y
BR2_PACKAGE_HOST_DOSFSTOOLS=y
BR2_PACKAGE_HOST_ENVIRONMENT_SETUP=y
BR2_PACKAGE_HOST_GENIMAGE=y
BR2_PACKAGE_HOST_MTOOLS=y
BR2_PACKAGE_HOST_PYTHON3=y
BR2_PACKAGE_CVITEKCONFIG_BOARD_RECAMERA=y
BR2_PACKAGE_CVITEKCONFIG_PANEL_NONE=y
BR2_PACKAGE_CLOUDUTILS=y
BR2_PACKAGE_CVITEK_MODULES=y
BR2_PACKAGE_CVITEK_PINMUX=y
TARGET_PACKAGE_CVITEK_PINMUX=y
BR2_PACKAGE_CVITEK_MIDDLEWARE=n
BR2_PACKAGE_CVITEK_OSS=y
BR2_PACKAGE_MINIZ=y
BR2_PACKAGE_JSON_C=y
BR2_PACKAGE_TINYALSA=y
BR2_PACKAGE_ALSA_UTILS_AMIXER=y
TARGET_PACKAGE_CVITEK_FBTOOLS=y
BR2_TARGET_CVITEKFSBL=y
BR2_ENABLE_DEBUG=y
BR2_INIT_NONE=y
BR2_PACKAGE_NERVES_CONFIG=y
BR2_NERVES_SYSTEM_NAME="nerves_system_sg2002"
BR2_GLOBAL_PATCH_DIR="${BR2_EXTERNAL_NERVES_PATH}/patches $(NERVES_DEFCONFIG_DIR)/patches"
BR2_ROOTFS_SKELETON_CUSTOM=y
BR2_ROOTFS_SKELETON_CUSTOM_PATH="${BR2_EXTERNAL_NERVES_PATH}/board/nerves-common/skeleton"
BR2_ROOTFS_OVERLAY="${BR2_EXTERNAL_NERVES_PATH}/board/nerves-common/rootfs_overlay ${NERVES_DEFCONFIG_DIR}/rootfs-overlay"
BR2_ROOTFS_POST_BUILD_SCRIPT="${NERVES_DEFCONFIG_DIR}/post-build.sh ${BR2_EXTERNAL_NERVES_PATH}/board/nerves-common/post-build.sh"
BR2_ROOTFS_POST_IMAGE_SCRIPT="${NERVES_DEFCONFIG_DIR}/post-createfs.sh $(NERVES_DEFCONFIG_DIR)/board/sipeed/recamera/postinstall.sh"
BR2_PACKAGE_UTIL_LINUX_RFKILL=y
BR2_PACKAGE_UTIL_LINUX_MOUNT=y

# uboot
BR2_TARGET_UBOOT=y
BR2_TARGET_UBOOT_BUILD_SYSTEM_KCONFIG=y
BR2_TARGET_UBOOT_CUSTOM_GIT=y
BR2_TARGET_UBOOT_CUSTOM_REPO_URL="https://github.com/sophgo/u-boot-2021.10.git"
BR2_TARGET_UBOOT_CUSTOM_REPO_VERSION="050d49a7b19289407c9f9998e16869c97ced891c"
BR2_TARGET_UBOOT_CUSTOM_DTS_PATH="$(NERVES_DEFCONFIG_DIR)/board/sipeed/recamera/dts/*"
BR2_TARGET_UBOOT_CUSTOM_MAKEOPTS="CVIBOARD=recamera_sd CHIP=$(BR2_PACKAGE_CVITEKCONFIG_CHIP) STORAGE_TYPE=$(BR2_PACKAGE_CVITEKCONFIG_STORAGE) CONFIG_USE_DEFAULT_ENV=y PANEL_TUNING_PARAM=$(UBOOT_PANEL_TUNING_PARM)"
BR2_TARGET_UBOOT_USE_CUSTOM_CONFIG=y
BR2_TARGET_UBOOT_CUSTOM_CONFIG_FILE="${NERVES_DEFCONFIG_DIR}/uboot-config/uboot.defconfig"
# BR2_TARGET_UBOOT_NEEDS_DTC=y
# BR2_TARGET_UBOOT_NEEDS_PYLIBFDT=y
# BR2_TARGET_UBOOT_NEEDS_OPENSSL=y
BR2_TARGET_UBOOT_NEEDS_OPENSBI=y
# BR2_TARGET_UBOOT_FORMAT_BIN is not set
BR2_TARGET_UBOOT_FORMAT_CUSTOM=y
BR2_TARGET_UBOOT_FORMAT_CUSTOM_NAME="u-boot.bin"
BR2_PACKAGE_HOST_UBOOT_TOOLS=y
BR2_PACKAGE_HOST_UBOOT_TOOLS_FIT_SUPPORT=y
BR2_PACKAGE_HOST_UBOOT_TOOLS_ENVIMAGE=y
BR2_PACKAGE_HOST_UBOOT_TOOLS_ENVIMAGE_SOURCE="${NERVES_DEFCONFIG_DIR}/uboot-config/uboot.env"
BR2_PACKAGE_HOST_UBOOT_TOOLS_ENVIMAGE_SIZE="131072"
BR2_PACKAGE_NBTTY=y

# General utilities
BR2_PACKAGE_SED=y
BR2_PACKAGE_FINDUTILS=y
BR2_PACKAGE_GAWK=y
BR2_PACKAGE_GREP=y



# Firmware-related utilities and uboot
BR2_PACKAGE_MTD=y
BR2_PACKAGE_MTD_MTDPART=y
BR2_PACKAGE_AIC_FIRMWARE=y
BR2_PACKAGE_LINUX_FIRMWARE=y
BR2_PACKAGE_UBOOT_TOOLS=y
BR2_PACKAGE_UBOOT_TOOLS_FIT_SUPPORT=y
BR2_PACKAGE_UBOOT_TOOLS_MKIMAGE=y
BR2_PACKAGE_UBOOT_TOOLS_MKEFICAPSULE=y
BR2_PACKAGE_UBOOT_TOOLS_MKENVIMAGE=y
BR2_PACKAGE_UBOOT_TOOLS_DUMPIMAGE=y

# For SSL
BR2_PACKAGE_CA_CERTIFICATES=y

# Disk Utils
BR2_PACKAGE_UTIL_LINUX=y
BR2_PACKAGE_UTIL_LINUX_FSCK=y
BR2_PACKAGE_UTIL_LINUX_BINARIES=y
BR2_PACKAGE_E2FSPROGS=y
BR2_PACKAGE_E2FSPROGS_RESIZE2FS=y

# Watchdog
BR2_PACKAGE_WATCHDOG=y
BR2_PACKAGE_WATCHDOGD=y

# Camera related
BR2_PACKAGE_LIBCAMERA_V4L2=y
BR2_PACKAGE_V4L2LOOPBACK=y
BR2_PACKAGE_V4L2LOOPBACK_UTILS=y
BR2_PACKAGE_V4L_UTILS=y 
BR2_PACKAGE_V4L_UTILS_DECODE_TM6000=y
BR2_PACKAGE_V4L_UTILS_IR_KEYTABLE=y
BR2_PACKAGE_V4L_UTILS_MEDIA_CTL=y
BR2_PACKAGE_V4L_UTILS_DECODE_TM6000=y
BR2_PACKAGE_FFMPEG=y
BR2_PACKAGE_FFMPEG_FFMPEG=y
BR2_PACKAGE_GSTREAMER1=y
BR2_PACKAGE_GST1_PLUGINS_BASE=y
BR2_PACKAGE_GST1_PLUGINS_GOOD=y
BR2_PACKAGE_GST1_PLUGINS_BAD=y

# Streaming related
BR2_PACKAGE_LIBSRTP=y

# SSCMA (TPU & Camera)
BR2_PACKAGE_SSCMA_NODE=y
BR2_PACKAGE_SSCMA_ELIXIR=y

# Configure RAM usage for ION
BR2_PACKAGE_CVITEKCONFIG_ALLOCATE_ION_HEAP=64
BR2_PACKAGE_CVITEKCONFIG_ALLOCATE_FREERTOS_HEAP=1
BR2_PACKAGE_CVITEKCONFIG_ALLOCATE_H26X_BITSTREAM_HEAP=1
BR2_PACKAGE_CVITEKCONFIG_ALLOCATE_ISP_HEAP=8

# Needed for newer nerves system
BR2_PACKAGE_RNG_TOOLS=y
BR2_PACKAGE_NERVES_CONFIG_ACCEPT_RNG_NOTICE=y
```

## package/Config.in
```kconfig
source "$NERVES_DEFCONFIG_DIR/package/aic-firmware/Config.in"
source "$NERVES_DEFCONFIG_DIR/package/cloudutils/Config.in"
source "$NERVES_DEFCONFIG_DIR/package/cvitek-modules/Config.in"
source "$NERVES_DEFCONFIG_DIR/package/cvitek-middleware/Config.in"
source "$NERVES_DEFCONFIG_DIR/package/miniz/Config.in"
source "$NERVES_DEFCONFIG_DIR/package/cvitek-oss/Config.in"
source "$NERVES_DEFCONFIG_DIR/package/cvitek-fbtools/Config.in"
source "$NERVES_DEFCONFIG_DIR/package/cvitek-pinmux/Config.in"
source "$NERVES_DEFCONFIG_DIR/package/sscma-node/Config.in"
source "$NERVES_DEFCONFIG_DIR/package/recamera-sdk/Config.in"
source "$NERVES_DEFCONFIG_DIR/package/libhv/Config.in"
```

## package/cvitek-pinmux/Config.in
```kconfig
config BR2_PACKAGE_CVITEK_PINMUX
  bool "PinMux"
  default y
  help
    cvitek PinMux utility
```

## package/libhv/Config.in
```kconfig
config BR2_PACKAGE_LIBHV
	bool "libhv"
	default y
    select BR2_PACKAGE_C_ARES
	help
	  This is the help text for the libhv package.
	  It will be displayed in the Buildroot configuration menu.
```

## package/recamera-sdk/Config.in
```kconfig
config BR2_PACKAGE_RECAMERA_SDK
    bool "reCameraOS SDK"
    help
      Fetch and stage the reCameraOS SDK drop used by SSCMA-based components.
```

## package/sscma-elixir/Config.in
```kconfig
config BR2_PACKAGE_SSCMA_ELIXIR
    bool "sscma-elixir"
    default y
    select BR2_PACKAGE_LIBHV
    select BR2_PACKAGE_ALSA_LIB
    select BR2_PACKAGE_ALSA_LIB_PCM
    select BR2_PACKAGE_RECAMERA_SDK
    select BR2_PACKAGE_JSON_FOR_MODERN_CPP
    select BR2_PACKAGE_MOSQUITTO
    help
      Minimal C++ application using reCamera SDK to provide access
      to SSCMA data (camera, TPU) to elixir. Builds a single
      binary: `sscma-elixir`.
```

## package/sscma-simple/Config.in
```kconfig
config BR2_PACKAGE_SSCMA_SIMPLE
    bool "sscma-simple"
    default y
    select BR2_PACKAGE_LIBHV
    select BR2_PACKAGE_ALSA_LIB
    select BR2_PACKAGE_ALSA_LIB_PCM
    select BR2_PACKAGE_RECAMERA_SDK
    select BR2_PACKAGE_JSON_FOR_MODERN_CPP
    select BR2_PACKAGE_MOSQUITTO
    help
      Minimal C++ application template using reCamera SDK and ALSA. Builds a
      single binary `sscma-simple`.
      Source lives in `package/sscma-simple/src/main.cpp`.
```

## packages/cvitekfsbl/Config.in
```kconfig
config BR2_PACKAGE_CVITEKFSBL
	bool "cvitek-fsbl"
	depends on BR2_riscv
	depends on BR2_PACKAGE_UBOOT
	depends on BR2_PACKAGE_OPENSBI
	help
	  CVITEK First Stage Boot Loader for SG2002 SoC

	  https://github.com/sophgo/fsbl 
```

## uboot/uboot.defconfig
```kconfig
CONFIG_RISCV=y
CONFIG_SYS_MALLOC_F_LEN=0x2000
CONFIG_NR_DRAM_BANKS=1
CONFIG_DEFAULT_DEVICE_TREE="soph_asic"
CONFIG_PRE_CON_BUF_ADDR=0
CONFIG_DEBUG_UART_BASE=0x04140000
CONFIG_DEBUG_UART_CLOCK=24000000
CONFIG_IDENT_STRING=" soph"
CONFIG_DEBUG_UART=y
CONFIG_ARCH_RV64I=y
CONFIG_RISCV_SMODE=y
CONFIG_TARGET_CVITEK_CV181X=y
CONFIG_DISTRO_DEFAULTS=y
CONFIG_FIT=y
# CONFIG_ARCH_FIXUP_FDT_MEMORY is not set
CONFIG_BOOTDELAY=1
CONFIG_PRE_CONSOLE_BUFFER=y
CONFIG_LOG=y
CONFIG_SYS_PROMPT="soph# "
# CONFIG_CMD_CONSOLE is not set
# CONFIG_CMD_XIMG is not set
# CONFIG_CMD_EDITENV is not set
# CONFIG_CMD_CRC32 is not set
# CONFIG_CMD_LZMADEC is not set
# CONFIG_CMD_UNLZ4 is not set
# CONFIG_CMD_UNZIP is not set
# CONFIG_CMD_LOADS is not set
CONFIG_CMD_MMC=y
# CONFIG_CMD_ITEST is not set
CONFIG_CMD_CACHE=y
# CONFIG_ISO_PARTITION is not set
# CONFIG_EFI_PARTITION is not set
CONFIG_NET_RANDOM_ETHADDR=y
CONFIG_MMC=y
CONFIG_MMC_SDHCI=y
CONFIG_MMC_SDHCI_SDMA=y
CONFIG_MMC_SDHCI_CVITEK=y
CONFIG_MTD=y
CONFIG_PHY_CVITEK=y
CONFIG_DM_ETH=y
CONFIG_ETH_DESIGNWARE=y
CONFIG_DEBUG_UART_ANNOUNCE=y
CONFIG_SYS_NS16550=y
CONFIG_SPI=y
CONFIG_LZ4=y
CONFIG_LZMA=y
# CONFIG_TOOLS_LIBCRYPTO is not set
CONFIG_DM_MMC=y
CONFIG_MMC_WRITE=y
CONFIG_MMC_QUIRKS=y
CONFIG_MMC_HW_PARTITIONING=y
CONFIG_MMC_VERBOSE=y
CONFIG_CMD_PART=y


CONFIG_ENV_IS_NOWHERE=y
CONFIG_DM=y


CONFIG_CMDLINE=y
CONFIG_HUSH_PARSER=y
CONFIG_CMDLINE_EDITING=y
CONFIG_AUTO_COMPLETE=y
CONFIG_SYS_LONGHELP=y
CONFIG_CMD_BOOTD=y
CONFIG_CMD_BOOTM=y
CONFIG_CMD_GO=y
CONFIG_CMD_RUN=y
CONFIG_CMD_SYSBOOT=y
CONFIG_CMD_FDT=y
CONFIG_PARTITIONS=y
CONFIG_DOS_PARTITION=y
CONFIG_PARTITION_UUIDS=y
CONFIG_CMD_EXT2=y
CONFIG_CMD_EXT4=y
CONFIG_CMD_FAT=y
CONFIG_CMD_FS_GENERIC=y
CONFIG_OF_CONTROL=y
CONFIG_OF_SEPARATE=y
CONFIG_OF_LIBFDT=y
```
